## backend/tests/fixtures/fake_klipper/src/Kconfig
```kconfig
# Minimal self-contained Kconfig used by the firmware-config editor tests.
# Mirrors the shape of Klipper's real src/Kconfig (a choice + symbols + a
# dependency) without needing a Klipper checkout.

mainmenu "Fake Klipper Firmware Configuration"

choice
	prompt "Micro-controller Architecture"

config MACH_DEMO_STM32
	bool "STMicroelectronics STM32"

config MACH_DEMO_AVR
	bool "Atmel AVR"

endchoice

config DEMO_CLOCK_FREQ
	int "Clock Frequency"
	default 8000000

config DEMO_USB
	bool "Use USB for communication"
	default y

config DEMO_SERIAL
	string "Serial device"
	default "/dev/ttyAMA0"
	depends on !DEMO_USB

# Gate symbol Klipper hides extra menus behind; the editor force-enables it so
# the dependent option is always visible (see _FORCE_VISIBLE).
config LOW_LEVEL_OPTIONS
	bool "Enable extra low-level configuration options"
	default n

config DEMO_LOWLEVEL_TWEAK
	bool "A low-level tweak"
	default n
	depends on LOW_LEVEL_OPTIONS

# A menu + a bare comment: kconfiglib MenuNodes for these have NO `help` slot,
# so serializing them must not touch `node.help` directly (regression guard).
menu "Demo low-level menu"

comment "Read the docs before changing these"

config DEMO_MENU_OPT
	bool "An option inside a menu"
	default n

endmenu
```
